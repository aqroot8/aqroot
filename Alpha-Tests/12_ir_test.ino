/*
 * AQROOT ALPHA TEST 12 - INFRARED (IR) TX + RX  [PASSED 2026-07-25]
 * -----------------------------------------------------------------
 * Parts : TSOP38238 (38kHz IR receiver) + TSAL6200 (940nm IR LED)
 * Board : ESP32S3 Dev Module | USB CDC On Boot = ENABLED
 *         Native USB port | 16MB flash | OPI PSRAM
 * Lib   : "IRremoteESP8266" by David Conran (RX/decode only)
 *
 * WIRING (bench)
 *   TSOP38238 (lens facing you, legs down):
 *     pin1 OUT -> GPIO 18   pin2 GND -> GND   pin3 VS -> 3V3
 *   TSAL6200:
 *     LONG leg (anode) -> [150R] -> GPIO 17
 *     SHORT leg (flat side) -> GND
 *
 * PINS: bench uses 17/18. Beta pin map uses 43/44 (avoided on the
 * bench because DevKits wire 43/44 to the USB-UART bridge chip).
 * Note 17/18 collide with SX1262 CS/DIO1 on this bench - the radio
 * was unplugged for this test. Free bench pins: 9, 38, 47, 48.
 *
 * KEY FIXES THAT MADE THIS WORK:
 *  1. The RECEIVER STAYS ENABLED during transmit. Calling
 *     irrecv.disableIRIn() before sending makes the receiver deaf
 *     while the LED emits - loopback can never succeed. Do NOT wrap
 *     the send in noInterrupts() either; IRrecv's sampling ISR must
 *     keep running.
 *  2. The 38kHz carrier is generated by LEDC HARDWARE PWM.
 *     IRremoteESP8266 bit-bangs a software carrier on ESP32 which is
 *     unreliable on the S3.
 *  3. A GPIO-driven TSAL6200 is DIM (~7mA average at 150R / 50% duty
 *     vs 100-500mA in a real remote). Range is 1-3cm, not 10-30cm.
 *     Aim the LED dome directly at the TSOP dome.
 *
 * RESULT: NEC 0x00FFE01F transmitted and decoded back, 3 of 4 frames
 * matched. The occasional miss is mark/space jitter from running with
 * interrupts enabled - native RMT in Beta generates timing in
 * hardware and will not have this issue.
 *
 * Keys: s = send NEC   r = reset counters
 */

#include <Arduino.h>
#include <IRremoteESP8266.h>
#include <IRrecv.h>
#include <IRutils.h>

#define IR_TX_PIN 17
#define IR_RX_PIN 18

#define AQ_CARRIER_HZ 38000
#define AQ_LEDC_CH    0
#define AQ_LEDC_RES   8
#define AQ_DUTY       128

const uint16_t kAqBufSize = 1024;
const uint8_t  kAqTimeout = 50;

IRrecv irrecv(IR_RX_PIN, kAqBufSize, kAqTimeout, true);
decode_results results;

const uint32_t kAqNecPayload = 0x00FFE01F;
uint32_t sent = 0, matched = 0;
bool awaiting = false;
uint32_t sentAt = 0;

inline void carrierWrite(uint8_t duty) {
#if ESP_ARDUINO_VERSION_MAJOR >= 3
  ledcWrite(IR_TX_PIN, duty);
#else
  ledcWrite(AQ_LEDC_CH, duty);
#endif
}

inline void mark(uint32_t us)  { carrierWrite(AQ_DUTY); delayMicroseconds(us); }
inline void space(uint32_t us) { carrierWrite(0);       delayMicroseconds(us); }

void sendNecHw(uint32_t data) {
  // interrupts stay ENABLED - IRrecv's sampling ISR must keep running
  mark(9000);  space(4500);
  for (int i = 31; i >= 0; i--) {
    mark(560);
    space((data & (1UL << i)) ? 1690 : 560);
  }
  mark(560);
  carrierWrite(0);
}

void doSend() {
  Serial.println();
  Serial.println(F("### SENDING NEC (receiver stays live) ###"));
  Serial.printf ("  payload 0x%08lX on GPIO %d\n",
                 (unsigned long)kAqNecPayload, IR_TX_PIN);
  sendNecHw(kAqNecPayload);
  sent++;
  awaiting = true;
  sentAt = millis();
  Serial.println(F("  sent - decoding..."));
}

void setup() {
  Serial.begin(115200);
  uint32_t t0 = millis();
  while (!Serial && (millis() - t0) < 3000) delay(10);
  delay(300);

#if ESP_ARDUINO_VERSION_MAJOR >= 3
  ledcAttach(IR_TX_PIN, AQ_CARRIER_HZ, AQ_LEDC_RES);
#else
  ledcSetup(AQ_LEDC_CH, AQ_CARRIER_HZ, AQ_LEDC_RES);
  ledcAttachPin(IR_TX_PIN, AQ_LEDC_CH);
#endif
  carrierWrite(0);

  irrecv.setUnknownThreshold(40);
  irrecv.enableIRIn();

  Serial.println();
  Serial.println(F("AQROOT TEST 12 - IR FULL VALIDATION"));
  Serial.printf ("TX GPIO %d  |  RX GPIO %d  |  carrier %d Hz\n",
                 IR_TX_PIN, IR_RX_PIN, AQ_CARRIER_HZ);
  Serial.println(F("Receiver stays enabled during transmit."));
  Serial.println(F("Keep LED 1-3cm from the TSOP dome."));
  Serial.println(F("Keys: s = send   r = reset"));
  Serial.println(F("Auto-send in 4s..."));
  delay(4000);
  doSend();
}

void loop() {
  if (irrecv.decode(&results)) {
    bool noise = (results.decode_type == UNKNOWN) || (results.bits < 12);
    if (!noise) {
      Serial.print(F("  [RX] "));
      Serial.print(typeToString(results.decode_type, results.repeat));
      Serial.print(F("  code "));
      Serial.print(resultToHexidecimal(&results));
      Serial.printf ("  bits %d\n", results.bits);

      if (awaiting && results.decode_type == NEC &&
          (uint32_t)results.value == kAqNecPayload) {
        matched++;
        awaiting = false;
        Serial.println();
        Serial.println(F("  ****************************************"));
        Serial.println(F("  ***   IR TX + RX FULLY VALIDATED     ***"));
        Serial.println(F("  ****************************************"));
        Serial.printf ("  matched %lu of %lu sent\n",
                       (unsigned long)matched, (unsigned long)sent);
        Serial.println();
      }
    }
    irrecv.resume();
  }

  if (awaiting && millis() - sentAt > 1500) {
    awaiting = false;
    Serial.println(F("  !! no NEC match this round"));
    Serial.println(F("     (if a signal decoded but the code differed,"));
    Serial.println(F("      timing jitter - press 's' to retry)"));
    Serial.println();
  }

  if (Serial.available()) {
    int c = Serial.read();
    if      (c == 's' || c == 'S') doSend();
    else if (c == 'r' || c == 'R') { sent = matched = 0; Serial.println(F("[reset]")); }
  }
}
